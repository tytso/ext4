## arch/arm/plat-mxc/Kconfig
```kconfig
if ARCH_MXC

menu "Freescale MXC Implementations"

choice
	prompt "MXC/iMX Base Type"
	default ARCH_MX3

config ARCH_MX2
	bool "MX2-based"
	help
	  This enables support for systems based on the Freescale i.MX2 family

config ARCH_MX3
	bool "MX3-based"
	help
	  This enables support for systems based on the Freescale i.MX3 family

config ARCH_MX51
    bool "MX51-based"
    help
      This enables support for systems based on Freescale i.MX51

endchoice

source "arch/arm/mach-mx2/Kconfig"
source "arch/arm/mach-mx3/Kconfig"
source "arch/arm/mach-mx51/Kconfig"

endmenu

config MXC_IRQ_PRIOR
	bool "Use IRQ priority"
	depends on ARCH_MXC
	help
	  Select this if you want to use prioritized IRQ handling.
	  This feature prevents higher priority ISR to be interrupted
	  by lower priority IRQ even IRQF_DISABLED flag is not set.
	  This may be useful in embedded applications, where are strong
	  requirements for timing.
	  Say N here, unless you have a specialized requirement.

config MXC_TZIC
	bool
	depends on ARCH_MXC

config DMA_ZONE_SIZE
	int "DMA memory zone size"
	range 0 64
	default 24
	help
	  This is the size in MB for the DMA zone. The DMA zone is used for
	  dedicated memory for large contiguous video buffers

# set iff we need the 1504 transceiver code
config ISP1504_MXC
	bool
	select ISP1504_MXC_OTG if USB_GADGET && USB_EHCI_HCD && USB_OTG
	default y if USB_EHCI_FSL_1504 || USB_GADGET_FSL_1504

config ISP1504_MXC_OTG
	tristate
	help
	  Support for USB OTG pin detect using the ISP1504 transceiver on MXC platforms.

# set iff we need the UTMI transceiver code
config UTMI_MXC
	bool
	select UTMI_MXC_OTG if ARCH_MX25 && USB_GADGET && USB_EHCI_HCD && USB_OTG
	default y if USB_EHCI_FSL_UTMI || USB_GADGET_FSL_UTMI
	depends on ARCH_MX51

config UTMI_MXC_OTG
	tristate
	help
	  Support for USB OTG pin detect using the UTMI transceiver on MXC platforms.

endif
```

## drivers/media/video/mxc/capture/Kconfig
```kconfig
if VIDEO_MXC_CAMERA

menu "MXC Camera/V4L2 PRP Features support"
config VIDEO_MXC_IPU_CAMERA
	bool
	depends on VIDEO_MXC_CAMERA && MXC_IPU
	default y

choice
	prompt "Select Camera/TV Decoder"
	default MXC_CAMERA_OV3640
	depends on VIDEO_MXC_CAMERA

config MXC_CAMERA_OV3640
	tristate "OmniVision ov3640 camera support"
	depends on !VIDEO_MXC_EMMA_CAMERA
	---help---
	  If you plan to use the ov3640 Camera with your MXC system, say Y here.

endchoice

config MXC_IPU_PRP_VF_SDC
	tristate "Pre-Processor VF SDC library"
	depends on VIDEO_MXC_IPU_CAMERA && FB_MXC_SYNC_PANEL
	default y
	---help---
	  Use case PRP_VF_SDC:
		Preprocessing image from smart sensor for viewfinder and
		displaying it on synchronous display with SDC use case.
		If SDC BG is selected, Rotation will not be supported.
		CSI -> IC (PRP VF) -> MEM
		MEM -> IC (ROT) -> MEM
		MEM -> SDC (FG/BG)

config MXC_IPU_PRP_VF_ADC
	tristate "Pre-Processor VF ADC library"
	depends on VIDEO_MXC_IPU_CAMERA && FB_MXC_ASYNC_PANEL
	default y
	---help---
	  Use case PRP_VF_ADC:
		Preprocessing image from smart sensor for viewfinder and
		displaying it on asynchronous display.
		CSI -> IC (PRP VF) -> ADC2

config MXC_IPU_PRP_ENC
	tristate "Pre-processor Encoder library"
	depends on VIDEO_MXC_IPU_CAMERA
	default y
	---help---
	  Use case PRP_ENC:
		Preprocessing image from smart sensor for encoder.
		CSI -> IC (PRP ENC) -> MEM

endmenu

endif
```

## drivers/mxc/Kconfig
```kconfig
# drivers/video/mxc/Kconfig

if ARCH_MXC

menu "MXC support drivers"

config MXC_IPU
	bool "Image Processing Unit Driver"
	select MXC_IPU_V3 if ARCH_MX51
	help
	  If you plan to use the Image Processing unit, say
	  Y here. IPU is needed by Framebuffer and V4L2 drivers.

source "drivers/mxc/ipu3/Kconfig"

source "drivers/mxc/pmic/Kconfig"
source "drivers/mxc/security/Kconfig"
source "drivers/mxc/vpu/Kconfig"
source "drivers/mxc/bt/Kconfig"

endmenu

endif
```

## drivers/mxc/pmic/Kconfig
```kconfig
#
# PMIC device driver configuration
#

menu "MXC PMIC support"

config MXC_PMIC
	boolean

config MXC_PMIC_MC13892
	tristate "MC13892 PMIC"
	depends on ARCH_MXC && (I2C || SPI)
	select MXC_PMIC
	---help---
	  This is the MXC MC13892(PMIC) support. It include
	  ADC, Battery, Connectivity, Light, Power and RTC.

config MXC_PMIC_I2C
  	bool "Support PMIC I2C Interface"
	depends on MXC_PMIC_MC13892 && I2C

config MXC_PMIC_SPI
  	bool "Support PMIC SPI Interface"
	depends on (MXC_PMIC_MC13892 || MXC_PMIC_MC13783) && SPI

comment "MXC PMIC Client Drivers"
	depends on MXC_PMIC

source "drivers/mxc/pmic/mc13892/Kconfig"

endmenu
```

## drivers/mxc/security/Kconfig
```kconfig
menu "MXC Security Drivers"

config MXC_SECURITY_SCC2
        tristate "MXC SCC2 Driver"
        depends on ARCH_MX51
        default n
        ---help---
          This module contains the core API's for accessing the SCC2 module.
          If you are unsure about this, say N here.

config SCC_DEBUG
        bool "MXC SCC Module debugging"
        depends on MXC_SECURITY_SCC || MXC_SECURITY_SCC2
        ---help---
        This is an option for use by developers; most people should
        say N here.  This enables SCC module debugging.

if (ARCH_MX51)
source "drivers/mxc/security/sahara2/Kconfig"
endif

endmenu
```

## drivers/video/mxc/Kconfig
```kconfig
config FB_MXC
	tristate "MXC Framebuffer support"
	depends on FB && MXC_IPU
	select FB_CFB_FILLRECT
	select FB_CFB_COPYAREA
	select FB_CFB_IMAGEBLIT
	default y
	help
	  This is a framebuffer device for the MXC LCD Controller.
	  See <http://www.linux-fbdev.org/> for information on framebuffer
	  devices.

	  If you plan to use the LCD display with your MXC system, say
	  Y here.

config FB_MXC_SYNC_PANEL
	depends on FB_MXC
	tristate "Synchronous Panel Framebuffer"
	default y

config FB_MXC_EPSON_VGA_SYNC_PANEL
	depends on FB_MXC_SYNC_PANEL
	tristate "Epson VGA Panel"
	default n

config FB_MXC_TVOUT_TVE
	tristate "MXC TVE TV Out Encoder"
	depends on FB_MXC_SYNC_PANEL
	depends on MXC_IPU_V3

config FB_MXC_CH7026
	depends on FB_MXC_SYNC_PANEL
	tristate "Chrontel CH7026 VGA Interface Chip"
```
